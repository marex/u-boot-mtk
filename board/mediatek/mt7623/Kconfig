## board/mediatek/mt7623/Kconfig
```kconfig
if TARGET_MT7623

config SYS_VENDOR
	default "mediatek"

config SYS_BOARD
	default "mt7623"

config SYS_CONFIG_NAME
	default "mt7623"

config MTK_BROM_HEADER_INFO
	string
	default "lk=1"

endif
```

## board/planetcom/mt6797-gemini-pda/Kconfig
```kconfig
if TARGET_MT6797

config SYS_VENDOR
	default "planetcom"

config SYS_BOARD
	default "mt6797-gemini-pda"

config SYS_CONFIG_NAME
	default "mt6797-gemini-pda"

config MTK_SPL_PAD_SIZE
	hex
	default 0x10000

config MTK_BROM_HEADER_INFO
	string
	default "media=nor"

endif
```

## configs/mt6797-gemini-pda_defconfig
```kconfig
CONFIG_ARM=y
CONFIG_ARCH_MEDIATEK=y
CONFIG_SYS_TEXT_BASE=0x40080000
CONFIG_SYS_MALLOC_F_LEN=0x4000
CONFIG_NR_DRAM_BANKS=1
CONFIG_DEBUG_UART_BASE=0x11002000
CONFIG_DEBUG_UART_CLOCK=26000000
CONFIG_DEBUG_UART=y
CONFIG_FIT=y
CONFIG_FIT_VERBOSE=y
CONFIG_BOOTDELAY=3
CONFIG_SYS_CONSOLE_IS_IN_ENV=y
CONFIG_DEFAULT_FDT_FILE="mt6797-gemini-pda"
# CONFIG_DISPLAY_BOARDINFO is not set
CONFIG_HUSH_PARSER=y
CONFIG_SYS_PROMPT="U-Boot> "
CONFIG_CMD_BOOTMENU=y
# CONFIG_CMD_ELF is not set
CONFIG_CMD_DM=y
# CONFIG_CMD_FLASH is not set
CONFIG_CMD_GPIO=y
CONFIG_CMD_MMC=y
# CONFIG_CMD_NET is not set
CONFIG_CMD_CACHE=y
# CONFIG_PARTITIONS is not set
CONFIG_DEFAULT_DEVICE_TREE="mt6797-gemini-pda"
CONFIG_NET_RANDOM_ETHADDR=y
CONFIG_SPL_DM_SEQ_ALIAS=y
CONFIG_REGMAP=y
CONFIG_SYSCON=y
CONFIG_CLK=y
CONFIG_DM_GPIO=y
CONFIG_DM_MMC=y
CONFIG_MMC_MTK=y
CONFIG_PINCTRL=y
CONFIG_PINCONF=y
CONFIG_POWER_DOMAIN=y
CONFIG_RAM=y
CONFIG_DM_RESET=y
CONFIG_BAUDRATE=921600
CONFIG_DM_SERIAL=y
CONFIG_DEBUG_UART_MTK=y
CONFIG_DEBUG_UART_ANNOUNCE=y
CONFIG_DEBUG_UART_SKIP_INIT=y
CONFIG_MTK_SERIAL=y
CONFIG_TIMER=y
CONFIG_MTK_TIMER=y
CONFIG_WDT=y
# CONFIG_EFI_LOADER is not set
```
